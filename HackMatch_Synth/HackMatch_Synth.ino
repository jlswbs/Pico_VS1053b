// Hack-Match synth example - original code https://github.com/Quillington/Hack-Match-Synthesizer //

#include "hardware/structs/rosc.h"
#include "PicoSPI.h"

#define MP3_CLK   2
#define MP3_MOSI  3
#define MP3_MISO  4
#define MP3_CS    5
#define MP3_XDCS  17
#define MP3_DREQ  26
#define MP3_RST   13

#define SCI_MODE          0x00
#define SCI_STATUS        0x01
#define SCI_BASS          0x02
#define SCI_CLOCKF        0x03
#define SCI_DECODE_TIME   0x04
#define SCI_AUDATA        0x05
#define SCI_WRAM          0x06
#define SCI_WRAMADDR      0x07
#define SCI_HDAT0         0x08
#define SCI_HDAT1         0x09
#define SCI_AIADDR        0x0A
#define SCI_VOL           0x0B
#define SCI_AICTRL0       0x0C
#define SCI_AICTRL1       0x0D
#define SCI_AICTRL2       0x0E
#define SCI_AICTRL3       0x0F

#define SM_DIFF           0x00
#define SM_LAYER12        0x01
#define SM_RESET          0x02
#define SM_CANCEL         0x03
#define SM_EARSPEAKER_LO  0x04
#define SM_TESTS          0x05
#define SM_STREAM         0x06
#define SM_EARSPEAKER_HI  0x07
#define SM_DACT           0x08
#define SM_SDIORD         0x09
#define SM_SDISHARE       0x0A
#define SM_SDINEW         0x0B
#define SM_ADPCM          0x0C
#define SM_ADPCM_HP       0x0D
#define SM_LINE1          0x0E
#define SM_CLK_RANGE      0x0F

#define SAMPLE_RATE       22050
#define MAX_AMP           32767

  signed char sineTable[256], fm1, fm2;
  int indexFM = 0;
  const uint8_t SAMP_SIZE = 100;
  volatile bool readyToPlay = false;
  volatile int playCount = 0;
  int16_t sample;

typedef struct samp {
  uint8_t index;
  uint32_t duration;
  uint8_t volume;
  uint8_t stringLength;
  bool isLast;
  bool isLoop;
  int indexToLoop;
}Samp;
   
typedef struct synthSamp {
  int index;
  uint32_t duration;
  int volume;
  int fc;
  int fm;
  int decayFC;
  int riseFC;
  int depthFM;
  int decayFM;
  bool isLast;
  bool isLoop;
  int indexToLoop;
}SynthSamp;

Samp sampArray[] = {
  {0, 8000, 3, 97, 0, 0, 0},
  {1, 8000, 3, 97, 0, 0, 0},
  {2, 2000, 3, 97, 0, 0, 0},
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  {18, 30000, 1, 32, 0, 1, -1},
};

SynthSamp sampArraySynth[] = {
  {0, 8000, 0, (int)(8.0 * 164.81), (int)(8.0 * (164.81)), 5, 4, 8, 4, 0, 0, 0},
  {1, 2000, 0, (int)(8.0 * 146.83), (int)(8.0 * (146.83)), 5, 4, 8, 4, 0, 0, 0},
  {2, 14000, 0, (int)(8.0 * 164.81), (int)(8.0 * (164.81)), 5, 4, 8, 4, 0, 0, 0},
  {3, 6000, 0, (int)(8.0 * 174.61), (int)(8.0 * (174.61)), 5, 4, 8, 4, 0, 0, 0},
  {4, 2000, 0, (int)(8.0 * 174.61), (int)(8.0 * (174.61)), 5, 4, 8, 4, 0, 0, 0},
  {5, 6000, 0, (int)(8.0 * 164.81), (int)(8.0 * (164.81)), 5, 4, 8, 4, 0, 0, 0},
  {6, 2000, 0, (int)(8.0 * 146.83), (int)(8.0 * (146.83)), 5, 4, 8, 4, 0, 0, 0},
  {7, 24000, 0, (int)(8.0 * 164.81), (int)(8.0 * (164.81)), 5, 4, 8, 4, 0, 0, 0},

  {8, 8000, 0, (int)(8.0 * 164.81), (int)(8.0 * (164.81)), 5, 4, 8, 4, 0, 0, 0},
  {9, 2000, 0, (int)(8.0 * 146.83), (int)(8.0 * (146.83)), 5, 4, 8, 4, 0, 0, 0},
  {10, 14000, 0, (int)(8.0 * 164.81), (int)(8.0 * (164.81)), 5, 4, 8, 4, 0, 0, 0},
  {11, 6000, 0, (int)(8.0 * 174.61), (int)(8.0 * (174.61)), 5, 4, 8, 4, 0, 0, 0},
  {12, 2000, 0, (int)(8.0 * 174.61), (int)(8.0 * (174.61)), 5, 4, 8, 4, 0, 0, 0},
  {13, 6000, 0, (int)(8.0 * 164.81), (int)(8.0 * (164.81)), 5, 4, 8, 4, 0, 0, 0},
  {14, 2000, 0, (int)(8.0 * 146.83), (int)(8.0 * (146.83)), 5, 4, 8, 4, 0, 0, 0},
  {15, 24000, 0, (int)(8.0 * 164.81), (int)(8.0 * (164.81)), 5, 4, 8, 4, 0, 1, -1},
};

typedef struct stringChannel {
  bool isOn;
  uint16_t index;
  int channelArray[SAMP_SIZE];
  Samp sample;
}StringChannel;

typedef struct SynthChannel {
  bool isOn;
  uint16_t index;
  uint16_t mainAmpFall;
  uint16_t mainRisePhase;
  uint16_t mainAmpRise;
  uint16_t FMamp;
  uint16_t FMAcc;
  uint16_t mainAcc;
  SynthSamp sample;
}SynthChannel;

StringChannel channelArray[] = {
  {1, 0, {0}, sampArray[0]},
  {1, 0, {0}, sampArray[5]},
};

SynthChannel channelArraySynth[] = {
  {0, 0, MAX_AMP, MAX_AMP, 0, MAX_AMP, 0, 0, sampArraySynth[0]}
};

static inline void seed_random_from_rosc(){
  
  uint32_t random = 0;
  uint32_t random_bit;
  volatile uint32_t *rnd_reg = (uint32_t *)(ROSC_BASE + ROSC_RANDOMBIT_OFFSET);

  for (int k = 0; k < 32; k++) {
    while (1) {
      random_bit = (*rnd_reg) & 1;
      if (random_bit != ((*rnd_reg) & 1)) break;
    }

    random = (random << 1) | random_bit;
  }
  
  srand(random);
}

void WriteReg(unsigned char address, unsigned char highbyte, unsigned char lowbyte){
  
  while(!digitalRead(MP3_DREQ));
  digitalWrite(MP3_CS, LOW);
  PicoSPI0.transfer(0x02);
  PicoSPI0.transfer(address);
  PicoSPI0.transfer(highbyte);
  PicoSPI0.transfer(lowbyte);
  while(!digitalRead(MP3_DREQ));
  digitalWrite(MP3_CS, HIGH);
  
}

void WriteReg16(unsigned char address, unsigned int databyte){
  
  while(!digitalRead(MP3_DREQ));
  digitalWrite(MP3_CS, LOW);
  PicoSPI0.transfer(0x02);
  PicoSPI0.transfer(address);
  PicoSPI0.transfer((databyte >> 8) & 0xFF);
  PicoSPI0.transfer(databyte & 0xFF);
  while(!digitalRead(MP3_DREQ));
  digitalWrite(MP3_CS, HIGH);
  
}

unsigned int ReadReg(unsigned char address){
  
  while(!digitalRead(MP3_DREQ));
  digitalWrite(MP3_CS, LOW);
  PicoSPI0.transfer(0x03);
  PicoSPI0.transfer(address);
  char response1 = PicoSPI0.transfer(0xFF);
  while(!digitalRead(MP3_DREQ));
  char response2 = PicoSPI0.transfer(0xFF);
  while(!digitalRead(MP3_DREQ));
  digitalWrite(MP3_CS, HIGH);
  int resultvalue = response1 << 8;
  resultvalue |= response2;
  return resultvalue;
  
}

#define PLUGIN_SIZE 840

const static word plugin[PLUGIN_SIZE] PROGMEM = {
  0x0007,0x0001, /*copy 1*/
	0x8d00,
	0x0006,0x033c, /*copy 828*/
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	0x2a03,0x408e
};

void load_code(void){
  
  int i = 0;
  while (i< PLUGIN_SIZE) {
    word addr, n, val;
    addr = pgm_read_word (&(plugin[i++]));
    n = pgm_read_word (&(plugin[i++]));
    if (n & 0x8000U) {
      n &= 0x7FFF;
      val = pgm_read_word (&(plugin[i++]));
      while (n--) {
        WriteReg16(addr, val);       
      }
    } 
    else {
      while (n--) {
        val = pgm_read_word (&(plugin[i++]));
        WriteReg16(addr, val);        
      }
    }
  }
  return;
}

int FMSynth(SynthChannel *chan) {

  SynthSamp *sample = &chan->sample;
  if ((chan->index & 0x0ff) == 0) {
    chan->mainAmpFall = chan->mainAmpFall - (chan->mainAmpFall >> sample->decayFC) ;
    chan->mainRisePhase = chan->mainRisePhase - (chan->mainRisePhase >> sample->riseFC);
    chan->FMamp = chan->FMamp - (chan->FMamp >> sample->decayFM) ;
  }

  chan->mainAmpRise =  MAX_AMP - chan->mainRisePhase;
  uint32_t FCamp = (chan->mainAmpRise >> 8) * (chan->mainAmpFall >> 8) ;
  chan->FMAcc = chan->FMAcc + sample->fm ;
  uint8_t high_fm = (char)(chan->FMAcc >> 8) ;
  int8_t fm1 = sineTable[high_fm] ;
  chan->mainAcc = chan->mainAcc + (sample->fc + (fm1*(chan->FMamp >> sample->depthFM)));
  uint8_t high_main = (char)(chan->mainAcc >> 8) ;
  int num = 0;
  if ((int)sineTable[high_main] > 0) {
    num = 1;
  }
  if ((int)sineTable[high_main] < 0) {
    num = -1;
  }
  signed int output = 128 + ((FCamp >> 8) * (num)) ;
  
  chan->index = chan->index + 1;
  if (chan->index == sample->duration) {
    chan->index = 0;
    chan->mainAmpFall = MAX_AMP;
    chan->mainRisePhase = MAX_AMP;
    chan->mainAmpRise = 0;
    chan->FMamp = MAX_AMP;
    chan->FMAcc = 0;
    chan->mainAcc = 0;
    if (sample->isLoop) {
      if (sample->indexToLoop == -1) {
        chan->isOn = false;
        channelArray[1].isOn = true;
        channelArray[1].sample = sampArray[5];
      }
      else{
        chan->sample = sampArraySynth[sample->indexToLoop];
      }
    }
    else {
      if (!sample->isLast) {
        chan->sample = sampArraySynth[sample->index + 1];
      }
      else {
        chan->isOn = false;
      }
    }
  }
  return output;

}

int KSAlg(StringChannel *chan) {

  int output;
  Samp *sample = &chan->sample;
  int firstIndex = chan->index % sample->stringLength;
  int secondIndex;
  if (chan->index == sample->stringLength - 1) {
    secondIndex = 0;
  }
  else {
    secondIndex = firstIndex + 1;
  }
  if (chan->index >= sample->stringLength) {
    output = ((chan->channelArray[firstIndex] + chan->channelArray[secondIndex]) >> 1);
    chan->channelArray[firstIndex] = output;
  }
  else {
    output = (rand()%65536) >> sample->volume;
    chan->channelArray[firstIndex] = output;
  }
  chan->index = chan->index + 1;
  if (chan->index == sample->duration) {
    chan->index = 0;
    if (sample->isLoop) {
      if (sample->indexToLoop == -1) {
        chan->isOn = false;
        channelArraySynth[0].isOn = true;
        channelArraySynth[0].sample = sampArraySynth[0];
      }
      else {
        chan->sample = sampArray[sample->indexToLoop];
      }
    }
    else {
      if (!sample->isLast) {
        chan->sample = sampArray[sample->index + 1];
      }
      else {
        chan->isOn = false;
      }
    }
  }
  return output;

}

void setup() {

  seed_random_from_rosc();
  analogReadResolution(12);
    
  pinMode(MP3_DREQ, INPUT);
  pinMode(MP3_CS, OUTPUT);
  pinMode(MP3_XDCS, OUTPUT);
  pinMode(MP3_RST, OUTPUT);

  PicoSPI0.configure (MP3_CLK, MP3_MOSI, MP3_MISO, MP3_CS, 4000000, 0, true);
  PicoSPI0.transfer(0xFF);

  digitalWrite(MP3_RST, HIGH);
  digitalWrite(MP3_CS, HIGH);
  digitalWrite(MP3_XDCS, HIGH);

  load_code();

  WriteReg16(SCI_AICTRL0, SAMPLE_RATE); // sample rate
  //WriteReg16(SCI_AICTRL1, 0x10);      // GPIO4 is high if space for 32 samples
  WriteReg16(SCI_VOL, 0x0000);          // lower volume
  WriteReg16(SCI_AICTRL2, 50);          // set pcm volume
  WriteReg16(SCI_AIADDR, 0x0d00);       // start pcm mixer

  for (int i = 0; i < 256; i++) sineTable[i] = (char)(128.0f * sinf(TWO_PI*((float)i)/256.0f));

}

void KSAlgMaster() {

  long output;
  for (int i = 0; i < 2; i++){
    if (channelArray[i].isOn) {
      output += (KSAlg(&channelArray[i]) + (1024 >> channelArray[i].sample.volume));
    }
  }
  if (channelArraySynth[0].isOn) {
    output += (FMSynth(&channelArraySynth[0]) * 2);
  }
  while (!readyToPlay) {}
  sample = output>>1;
  readyToPlay = false;

}

void loop() {

  if (ReadReg(SCI_AICTRL0) > 32){

    for (int i = 0; i < 32; i++) {
 
      readyToPlay = true;
      playCount++;
     
      WriteReg16(SCI_AICTRL1, sample);
    
    }

  } 

}

void loop1() {

  KSAlgMaster();

}