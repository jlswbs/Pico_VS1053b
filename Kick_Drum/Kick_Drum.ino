// VLSI 1053 codec PCM mixer - random Kick drum //
// https://github.com/RideMyByte/Eurorack-NanoKick //

/*

  Pot1 = harmonic
  Pot2 = decay
  Pot3 = tempo
 
  Created by JLS 2024

*/

#include "hardware/structs/rosc.h"
#include "PicoSPI.h"

#define MP3_CLK   2
#define MP3_MOSI  3
#define MP3_MISO  4
#define MP3_CS    5
#define MP3_XDCS  17
#define MP3_DREQ  26
#define MP3_RST   13

#define SCI_MODE          0x00
#define SCI_STATUS        0x01
#define SCI_BASS          0x02
#define SCI_CLOCKF        0x03
#define SCI_DECODE_TIME   0x04
#define SCI_AUDATA        0x05
#define SCI_WRAM          0x06
#define SCI_WRAMADDR      0x07
#define SCI_HDAT0         0x08
#define SCI_HDAT1         0x09
#define SCI_AIADDR        0x0A
#define SCI_VOL           0x0B
#define SCI_AICTRL0       0x0C
#define SCI_AICTRL1       0x0D
#define SCI_AICTRL2       0x0E
#define SCI_AICTRL3       0x0F

#define SM_DIFF           0x00
#define SM_LAYER12        0x01
#define SM_RESET          0x02
#define SM_CANCEL         0x03
#define SM_EARSPEAKER_LO  0x04
#define SM_TESTS          0x05
#define SM_STREAM         0x06
#define SM_EARSPEAKER_HI  0x07
#define SM_DACT           0x08
#define SM_SDIORD         0x09
#define SM_SDISHARE       0x0A
#define SM_SDINEW         0x0B
#define SM_ADPCM          0x0C
#define SM_ADPCM_HP       0x0D
#define SM_LINE1          0x0E
#define SM_CLK_RANGE      0x0F

#define SAMPLE_RATE 22050
#define MAXBPM      120
#define MINBPM      60
#define MAXADC      4095
#define MINADC      0

float randomf(float minf, float maxf) { return minf + (rand()%(1UL << 31))*(maxf - minf) / (1UL << 31); }

class Synth {
public:

  bool trig = 0;
  bool noise = 0;
  int wave = 0;
  int h = 0;
  int i = 0;
  int j = 0;
  float k = 1;
  float vol = 0.0f;
  float tone = 0.0f;
  int harm = 0;
  int decay = 0;

  int fand[180] = { 0, 17, 34, 52, 69, 86, 103, 120, 137, 154, 171, 187, 203,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 -35, -18 };
  int harmo[180] = { 0, 416, 365, 321, 334, 307, 279, 279, 254, 232, 227, 203, 185,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 -366, -417 };

	int calculate();

};

int Synth::calculate() {

  if (trig == 1) {
    h = 0;
    i = 0;
    j = 0;
    k = 1.0f;
  }

  int freq = 12 * (1.0f - tone);

  if (i > 179) {

    h ++;
    i = 0;
    j = j + 5;
    k =  k * (94 - (32 - decay)) / 100 - 10 / 100;

  }

  delayMicroseconds(j*freq);

  if (noise) wave = (fand[rand()%180] * 32 + harmo[i] * (32 - harm)) >> 2;
  else wave = fand[i] * 32 + harmo[i] * (32 - harm);

  i ++;

  return vol * (wave * k);

}

Synth kick;

static inline void seed_random_from_rosc(){
  
  uint32_t random = 0;
  uint32_t random_bit;
  volatile uint32_t *rnd_reg = (uint32_t *)(ROSC_BASE + ROSC_RANDOMBIT_OFFSET);

  for (int k = 0; k < 32; k++) {
    while (1) {
      random_bit = (*rnd_reg) & 1;
      if (random_bit != ((*rnd_reg) & 1)) break;
    }

    random = (random << 1) | random_bit;
  }
  
  srand(random);
}

void WriteReg(unsigned char address, unsigned char highbyte, unsigned char lowbyte){
  
  while(!digitalRead(MP3_DREQ));
  digitalWrite(MP3_CS, LOW);
  PicoSPI0.transfer(0x02);
  PicoSPI0.transfer(address);
  PicoSPI0.transfer(highbyte);
  PicoSPI0.transfer(lowbyte);
  while(!digitalRead(MP3_DREQ));
  digitalWrite(MP3_CS, HIGH);
  
}

void WriteReg16(unsigned char address, unsigned int databyte){
  
  while(!digitalRead(MP3_DREQ));
  digitalWrite(MP3_CS, LOW);
  PicoSPI0.transfer(0x02);
  PicoSPI0.transfer(address);
  PicoSPI0.transfer((databyte >> 8) & 0xFF);
  PicoSPI0.transfer(databyte & 0xFF);
  while(!digitalRead(MP3_DREQ));
  digitalWrite(MP3_CS, HIGH);
  
}

unsigned int ReadReg(unsigned char address){
  
  while(!digitalRead(MP3_DREQ));
  digitalWrite(MP3_CS, LOW);
  PicoSPI0.transfer(0x03);
  PicoSPI0.transfer(address);
  char response1 = PicoSPI0.transfer(0xFF);
  while(!digitalRead(MP3_DREQ));
  char response2 = PicoSPI0.transfer(0xFF);
  while(!digitalRead(MP3_DREQ));
  digitalWrite(MP3_CS, HIGH);
  int resultvalue = response1 << 8;
  resultvalue |= response2;
  return resultvalue;
  
}

#define PLUGIN_SIZE 840

const static word plugin[PLUGIN_SIZE] PROGMEM = {
  0x0007,0x0001, /*copy 1*/
	0x8d00,
	0x0006,0x033c, /*copy 828*/
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	0x2a03,0x408e};


void load_code(void){
  
  int i = 0;
  while (i< PLUGIN_SIZE) {
    word addr, n, val;
    addr = pgm_read_word (&(plugin[i++]));
    n = pgm_read_word (&(plugin[i++]));
    if (n & 0x8000U) {
      n &= 0x7FFF;
      val = pgm_read_word (&(plugin[i++]));
      while (n--) {
        WriteReg16(addr, val);       
      }
    } 
    else {
      while (n--) {
        val = pgm_read_word (&(plugin[i++]));
        WriteReg16(addr, val);        
      }
    }
  }
  return;
}

void setup(){

  seed_random_from_rosc();
  analogReadResolution(12);
    
  pinMode(MP3_DREQ, INPUT);
  pinMode(MP3_CS, OUTPUT);
  pinMode(MP3_XDCS, OUTPUT);
  pinMode(MP3_RST, OUTPUT);

  PicoSPI0.configure (MP3_CLK, MP3_MOSI, MP3_MISO, MP3_CS, 4000000, 0, true);
  PicoSPI0.transfer(0xFF);

  digitalWrite(MP3_RST, HIGH);
  digitalWrite(MP3_CS, HIGH);
  digitalWrite(MP3_XDCS, HIGH);

  load_code();

  WriteReg16(SCI_AICTRL0, SAMPLE_RATE);   // sample rate
  //WriteReg16(SCI_AICTRL1, 0x10);  // GPIO4 is high if space for 32 samples
  WriteReg16(SCI_VOL, 0x0000);      // lower volume
  WriteReg16(SCI_AICTRL2, 50);      // set pcm volume
  WriteReg16(SCI_AIADDR, 0x0d00);   // start pcm mixer

}

void setup1(){

}

void loop(){

  if (ReadReg(SCI_AICTRL0) > 32){   
    
    for (int i = 0; i < 32; i++) { 
      
      int16_t sample = kick.calculate();
      WriteReg16(SCI_AICTRL1, sample);
    
    }
  
  }

}

void loop1(){

  kick.trig = 1;
  kick.noise = rand()%2;
  kick.vol = randomf(0.4f, 0.9f);
  kick.decay = map(analogRead(A2), MINADC, MAXADC, 8, 32);
  kick.harm = map(analogRead(A1), MINADC, MAXADC, 31, 0);
  kick.tone = randomf(0.1f, 0.9f);
 
  delay(1);

  kick.trig = 0;

  uint16_t del = map(analogRead(A3), MINADC, MAXADC, MINBPM, MAXBPM);
  int tempo = 60000 / del;
  delay((tempo / 4) - 1);

}