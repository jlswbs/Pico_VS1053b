// VLSI 1053 codec PCM mixer - Fold sine wave + echoverb //

/*

  Pot1 = fold wave
  Pot2 = echo mix volume
  Pot3 = tempo
 
  Created by JLS 2024

*/

#include "hardware/structs/rosc.h"
#include "PicoSPI.h"

#define MP3_CLK   2
#define MP3_MOSI  3
#define MP3_MISO  4
#define MP3_CS    5
#define MP3_XDCS  17
#define MP3_DREQ  26
#define MP3_RST   13

#define SCI_MODE          0x00
#define SCI_STATUS        0x01
#define SCI_BASS          0x02
#define SCI_CLOCKF        0x03
#define SCI_DECODE_TIME   0x04
#define SCI_AUDATA        0x05
#define SCI_WRAM          0x06
#define SCI_WRAMADDR      0x07
#define SCI_HDAT0         0x08
#define SCI_HDAT1         0x09
#define SCI_AIADDR        0x0A
#define SCI_VOL           0x0B
#define SCI_AICTRL0       0x0C
#define SCI_AICTRL1       0x0D
#define SCI_AICTRL2       0x0E
#define SCI_AICTRL3       0x0F

#define SM_DIFF           0x00
#define SM_LAYER12        0x01
#define SM_RESET          0x02
#define SM_CANCEL         0x03
#define SM_EARSPEAKER_LO  0x04
#define SM_TESTS          0x05
#define SM_STREAM         0x06
#define SM_EARSPEAKER_HI  0x07
#define SM_DACT           0x08
#define SM_SDIORD         0x09
#define SM_SDISHARE       0x0A
#define SM_SDINEW         0x0B
#define SM_ADPCM          0x0C
#define SM_ADPCM_HP       0x0D
#define SM_LINE1          0x0E
#define SM_CLK_RANGE      0x0F

#define SAMPLE_RATE 22050
#define MAXBPM      350
#define MINBPM      60
#define MAXADC      4095
#define MINADC      0
#define WTB_LEN     4096
#define BUFF_SIZE   4096

float randomf(float minf, float maxf) { return minf + (rand()%(1UL << 31))*(maxf - minf) / (1UL << 31); }

float table[WTB_LEN];
unsigned int buff_pos = 0;
float buff[BUFF_SIZE];
float mix, lim;

class Synth {
public:
	float pointer = 0.0f;
  float vol = 0.0f;
	float pitch = 0.0f;
  bool gate = 0;
  float decay = 0.0f;
  float d = 0.0f;

	float calculate();
};

float Synth::calculate() {

	int a, b;
	float da, db;

	float wtb_incr = WTB_LEN * (pitch) / SAMPLE_RATE;
	pointer = pointer + wtb_incr;

	if (pointer > WTB_LEN) pointer = pointer - WTB_LEN;

	a = pointer;
	da = pointer - a;
	b = a + 1;
	db = b - pointer;

	if (b >= WTB_LEN) b = 0;
  if (gate == 1) d = 1.0f;
  else d = d;

  d = d - decay;
  if (d <= 0.0f) d = 0.0f;


	float osc = db * (table[a]) + da * (table[b]);

	return vol * (d * osc);

}

Synth osc1;

float fold(float x, float lim) {
  
  float out = x;
  
  while (out > lim || out < -lim){
    
    if (out > lim) out = lim - (out - lim);
    else if (out < -lim) out = -lim + (-out-lim);
    
  }
    
  return out;

}

float echo_verb(float sample, float decay) {

  float old_sample = buff[buff_pos];
  float new_sample = (sample + (old_sample * decay)) / 2.0f;
  buff[buff_pos] = new_sample;
  buff_pos = buff_pos + 1;
  if (buff_pos == BUFF_SIZE) buff_pos = 0; 
  return new_sample;

}

static inline void seed_random_from_rosc(){
  
  uint32_t random = 0;
  uint32_t random_bit;
  volatile uint32_t *rnd_reg = (uint32_t *)(ROSC_BASE + ROSC_RANDOMBIT_OFFSET);

  for (int k = 0; k < 32; k++) {
    while (1) {
      random_bit = (*rnd_reg) & 1;
      if (random_bit != ((*rnd_reg) & 1)) break;
    }

    random = (random << 1) | random_bit;
  }
  
  srand(random);
}

void WriteReg(unsigned char address, unsigned char highbyte, unsigned char lowbyte){
  
  while(!digitalRead(MP3_DREQ));
  digitalWrite(MP3_CS, LOW);
  PicoSPI0.transfer(0x02);
  PicoSPI0.transfer(address);
  PicoSPI0.transfer(highbyte);
  PicoSPI0.transfer(lowbyte);
  while(!digitalRead(MP3_DREQ));
  digitalWrite(MP3_CS, HIGH);
  
}

void WriteReg16(unsigned char address, unsigned int databyte){
  
  while(!digitalRead(MP3_DREQ));
  digitalWrite(MP3_CS, LOW);
  PicoSPI0.transfer(0x02);
  PicoSPI0.transfer(address);
  PicoSPI0.transfer((databyte >> 8) & 0xFF);
  PicoSPI0.transfer(databyte & 0xFF);
  while(!digitalRead(MP3_DREQ));
  digitalWrite(MP3_CS, HIGH);
  
}

unsigned int ReadReg(unsigned char address){
  
  while(!digitalRead(MP3_DREQ));
  digitalWrite(MP3_CS, LOW);
  PicoSPI0.transfer(0x03);
  PicoSPI0.transfer(address);
  char response1 = PicoSPI0.transfer(0xFF);
  while(!digitalRead(MP3_DREQ));
  char response2 = PicoSPI0.transfer(0xFF);
  while(!digitalRead(MP3_DREQ));
  digitalWrite(MP3_CS, HIGH);
  int resultvalue = response1 << 8;
  resultvalue |= response2;
  return resultvalue;
  
}

#define PLUGIN_SIZE 840

const static word plugin[PLUGIN_SIZE] PROGMEM = {
  0x0007,0x0001, /*copy 1*/
	0x8d00,
	0x0006,0x033c, /*copy 828*/
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	0x2a03,0x408e};


void load_code(void){
  
  int i = 0;
  while (i< PLUGIN_SIZE) {
    word addr, n, val;
    addr = pgm_read_word (&(plugin[i++]));
    n = pgm_read_word (&(plugin[i++]));
    if (n & 0x8000U) {
      n &= 0x7FFF;
      val = pgm_read_word (&(plugin[i++]));
      while (n--) {
        WriteReg16(addr, val);       
      }
    } 
    else {
      while (n--) {
        val = pgm_read_word (&(plugin[i++]));
        WriteReg16(addr, val);        
      }
    }
  }
  return;
}

void setup(){

  seed_random_from_rosc();
  analogReadResolution(12);
    
  pinMode(MP3_DREQ, INPUT);
  pinMode(MP3_CS, OUTPUT);
  pinMode(MP3_XDCS, OUTPUT);
  pinMode(MP3_RST, OUTPUT);

  PicoSPI0.configure (MP3_CLK, MP3_MOSI, MP3_MISO, MP3_CS, 4000000, 0, true);
  PicoSPI0.transfer(0xFF);

  digitalWrite(MP3_RST, HIGH);
  digitalWrite(MP3_CS, HIGH);
  digitalWrite(MP3_XDCS, HIGH);

  load_code();

  WriteReg16(SCI_AICTRL0, SAMPLE_RATE);   // sample rate
  //WriteReg16(SCI_AICTRL1, 0x10);  // GPIO4 is high if space for 32 samples
  WriteReg16(SCI_VOL, 0x0000);      // lower volume
  WriteReg16(SCI_AICTRL2, 50);      // set pcm volume
  WriteReg16(SCI_AIADDR, 0x0d00);   // start pcm mixer

  for (int i = 0; i < WTB_LEN; i++) table[i] = sinf(TWO_PI * (i / (float) WTB_LEN));

}

void setup1(){

}

void loop(){

  if (ReadReg(SCI_AICTRL0) > 32){   
    
    for (int i = 0; i < 32; i++) { 
      
      int16_t sample = 32767.0f * echo_verb(fold(osc1.calculate(), lim), mix);
      WriteReg16(SCI_AICTRL1, sample);
    
    }
  
  }

}

void loop1(){

  lim = map(analogRead(A1), MINADC, MAXADC, 9999, 499);
  lim /= 10000.0f;

  mix = map(analogRead(A2), MINADC, MAXADC, 499, 9999);
  mix /= 10000.0f;
  
  osc1.gate = 1;
  osc1.vol = randomf(0.2f, 0.9f);
  osc1.decay = randomf(0.1f, 0.9f) / SAMPLE_RATE * 10;
  osc1.pitch = randomf(50, 880);

  delay(1);

  osc1.gate = 0;

  uint16_t del = map(analogRead(A3), MINADC, MAXADC, MINBPM, MAXBPM);
  int tempo = 60000 / del;
  delay((tempo / 4) - 1);

}