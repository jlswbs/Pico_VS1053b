#include "hardware/structs/rosc.h"
#include "PicoSPI.h"

#define MP3_CLK   2
#define MP3_MOSI  3
#define MP3_MISO  4
#define MP3_CS    5
#define MP3_XDCS  17
#define MP3_DREQ  26
#define MP3_RST   13

#define SCI_MODE          0x00
#define SCI_STATUS        0x01
#define SCI_BASS          0x02
#define SCI_CLOCKF        0x03
#define SCI_DECODE_TIME   0x04
#define SCI_AUDATA        0x05
#define SCI_WRAM          0x06
#define SCI_WRAMADDR      0x07
#define SCI_HDAT0         0x08
#define SCI_HDAT1         0x09
#define SCI_AIADDR        0x0A
#define SCI_VOL           0x0B
#define SCI_AICTRL0       0x0C
#define SCI_AICTRL1       0x0D
#define SCI_AICTRL2       0x0E
#define SCI_AICTRL3       0x0F

#define SM_DIFF           0x00
#define SM_LAYER12        0x01
#define SM_RESET          0x02
#define SM_CANCEL         0x03
#define SM_EARSPEAKER_LO  0x04
#define SM_TESTS          0x05
#define SM_STREAM         0x06
#define SM_EARSPEAKER_HI  0x07
#define SM_DACT           0x08
#define SM_SDIORD         0x09
#define SM_SDISHARE       0x0A
#define SM_SDINEW         0x0B
#define SM_ADPCM          0x0C
#define SM_ADPCM_HP       0x0D
#define SM_LINE1          0x0E
#define SM_CLK_RANGE      0x0F

#define SAMPLE_RATE       22050

int frameTime = 15; // ms
int formantScale = 64;

const int FIXED_BITS = 14;
const int FIXED_SCALE = (1 << FIXED_BITS);
const int REVERB_SIZE = 0x2000;
const int REVERB_LENGTH = (int)(REVERB_SIZE * 0.9f);
const int REVERB_DECAY = (int)(FIXED_SCALE * 0.7f);

int16_t reverbAddr;
int reverbBuffer[REVERB_SIZE];

uint16_t pitchPhase, form1Phase,form2Phase,form3Phase;
uint16_t pitchPhaseInc,form1PhaseInc,form2PhaseInc,form3PhaseInc;
uint8_t form1Amp,form2Amp,form3Amp;

int8_t sinCalc[256] PROGMEM = {
  0,0,0,0,0,0,0,0,0,0,0,0,0,0,0,0,
  0,2,2,3,3,4,5,6,7,8,10,12,14,17,20,24,
  0,4,4,5,6,7,9,11,13,15,18,22,26,31,37,45,
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  0,-2,-2,-3,-3,-4,-5,-6,-7,-8,-10,-12,-14,-17,-20,-24
};

int8_t sqrCalc[256] PROGMEM ={
  0,1,2,2,2,3,3,4,5,5,6,8,9,11,13,16,
  0,1,2,2,2,3,3,4,5,5,6,8,9,11,13,16,
  0,1,2,2,2,3,3,4,5,5,6,8,9,11,13,16,
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  0,-1,-2,-2,-2,-3,-3,-4,-5,-5,-6,-8,-9,-11,-13,-16
};

#define FORMANT_SZ 7

enum {
  SP,DOT,QM,COM,HYP,IY,IH,EH,AE,AA,
  AH,AO,UH,AX,IX,ER,UX,OH,RX,LX,
  WX,YX,WH,R,L,W,Y,M,N,NX,
  DX,Q,S,SH,F,TH,H,X,Z,ZH,
  V,DH,CHa,CHb,Ja,Jb,Jc,Jd,EY,AY,
  OY,AW,OW,UW,Ba,Bb,Bc,Da,Db,Dc,
  Ga,Gb,Gc,GXa,GXb,GXc,Pa,Pb,Pc,Ta,
  Tb,Tc,Ka,Kb,Kc,KXa,KXb,KXc
};

uint8_t formantTable[] PROGMEM = {
   0x0, 0x0, 0x0,0x0,0x0,0x0,0x0,/*00 space*/ 0x13,0x43,0x5b,0x0,0x0,0x0,0x0,/*01 .*/
  0x13,0x43,0x5b,0x0,0x0,0x0,0x0,/*02 ?*/     0x13,0x43,0x5b,0x0,0x0,0x0,0x0,/*03 ,*/
  0x13,0x43,0x5b,0x0,0x0,0x0,0x0,/*04 -*/      0xa,0x54,0x6e,0xd,0xa,0x8,0x0,/*05 IY*/
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   0x6,0x54,0x5e,0x0,0xa,0x5,0x0,/*76 KXb*/    0x6,0x54,0x5e,0x0,0x0,0x0,0x0 /*77 KXc*/
};

uint16_t pitchTable[64] = {
  // Covers A1 to C7
  58,61,65,69,73,77,82,86,92,97,
  103,109,115,122,129,137,145,154,163,173,
  183,194,206,218,231,244,259,274,291,308,
  326,346,366,388,411,435,461,489,518,549,
  581,616,652,691,732,776,822,871,923,978,
  1036,1097,1163,1232,1305,1383,1465,1552,1644,1742,
  1845,1955,2071,2195
};

uint8_t frameList[] PROGMEM = {
#if 1
  Da,3,0,39,Db,1,0,39,Dc,1,3,39,EY,8,6,39,YX,20,3,39, // Dai..
  Z,10,0,36,IY,35,3,36, // ..sy
  Da,3,0,32,Db,1,0,32,Dc,1,3,32,EY,8,6,32,YX,20,3,32, // Dai..
  Z,10,0,27,IY,35,3,27, // ..sy
  Ga,2,0,29,Gb,2,0,29,Gc,2,0,29,IH,10,3,29,V,5,0,29, // Give
  M,2,0,31,IY,10,3,31, // me
  YX,5,0,32,AO,10,0,32,RX,5,0,32, // your
  AH,25,0,29,NX,5,0,29, // an..
  S,2,0,32,ER,10,0,32,RX,3,0,32, // ..swer
  Da,3,0,27,Db,1,0,27,Dc,1,3,27,UX,80,3,27,WX,5,0,27, // do
  AY,5,20,34,YX,10,0,34,M,8,0,34, // I'm
  H,5,0,39,AX,30,0,39,F,10,0,39, // half
  Ka,3,0,36,Kb,3,0,36,Kc,4,0,36,R,5,0,36,EY,30,0,36, // cra..
  Z,5,0,32,IY,40,0,32, // ..zy
  AO,10,0,29,LX,5,0,29, // all
  F,5,0,31,AO,10,0,31, // for
  DH,5,0,32,AH,10,0,32, // the
  L,5,0,34,AH,20,0,34,V,5,0,34,// love
  AA,10,0,36,V,5,0,36,// of
  Y,10,0,34,UX,80,0,34, // you
  IH,10,0,36,Ta,2,0,36,Tb,1,0,36,Tc,2,0,36,// It
  W,2,0,37,OH,10,0,37,N,1,0,37,Ta,1,0,37,Tb,1,0,37,Tc,1,0,37,// won't
  Ba,2,0,36,Bb,1,0,36,Bc,2,0,36,IY,10,0,36,// be
  AH,15,0,34,// a
  S,2,0,39,Ta,2,0,39,Tb,2,0,39,Tc,2,0,39,AY,1,10,39,YX,10,0,39,// sty..
  L,3,0,36,IH,10,0,36,SH,2,0,36,// ..lish
  M,5,0,34,AE,10,0,34,// ma..
  R,5,0,32,IH,60,0,32,Ja,2,0,32,Jb,2,0,32,Jc,2,0,32,// ..rriage
  AY,5,10,34,YX,5,0,34,// I
  Ka,2,0,36,Kb,2,0,36,Kc,2,0,36,AH,20,0,36,N,2,0,36,Ta,2,0,36,Tb,2,0,26,Tc,2,0,36,// can't
  AX,15,0,32,// a..
  F,5,0,29,AO,20,0,29,R,2,0,29,Da,1,0,29,Db,1,0,29,Dc,1,0,29,// ..fford
  AX,15,0,32,// a
  Ka,1,0,29,Kb,1,0,29,Kc,1,0,29,AE,12,0,29,// ca..
  R,5,0,27,IH,45,0,27,Ja,2,0,27,Jb,2,0,27,Jc,2,0,27,// ..rriage
  Ba,1,0,27,Bb,1,0,27,Bc,1,0,27,AH,10,0,27,Ta,1,0,27,Tb,1,0,27,Tc,1,0,27,// but
  Y,5,0,32,UH,10,10,32,L,5,0,32,// you'll
  L,3,0,36,UH,10,0,36,Ka,1,0,36,Kb,1,0,36,Kc,1,0,36,// look
  S,2,0,34,W,2,0,34,IY,20,0,34,Ta,2,0,34,Tb,2,0,34,Tc,2,0,34,// sweet
  AX,15,0,27,// a..
  Ka,2,0,32,Kb,2,0,32,Kc,2,0,32,R,2,0,32,AA,20,0,32,S,5,0,32,// ..cross
  DH,5,0,36,AH,10,0,36,// the
  S,2,0,34,IY,10,0,34,Ta,2,0,34,Tb,2,0,34,Tc,2,0,34,// seat
  AA,10,0,36,V,5,0,36,// of
  AE,15,0,37,// a
  Ba,2,0,39,Bb,2,0,39,Bc,2,0,39,AY,5,5,39,YX,5,0,39,// bi..
  S,5,0,36,IH,10,0,36,// ..cy..
  Ka,2,0,32,Kb,2,0,32,Kc,2,0,32,L,9,0,32,// ..cle
  M,2,0,34,EY,5,10,34,YX,10,0,34,Da,2,0,34,Db,2,0,34,Dc,2,0,34,// made
  F,5,0,27,OY,1,5,27,RX,5,0,27,// for
  Ta,2,0,32,Tb,2,0,32,Tc,2,0,32,UX,50,0,32,// two
  #endif
  Ta,0,0,61
};

static inline void seed_random_from_rosc(){
  
  uint32_t random = 0;
  uint32_t random_bit;
  volatile uint32_t *rnd_reg = (uint32_t *)(ROSC_BASE + ROSC_RANDOMBIT_OFFSET);

  for (int k = 0; k < 32; k++) {
    while (1) {
      random_bit = (*rnd_reg) & 1;
      if (random_bit != ((*rnd_reg) & 1)) break;
    }

    random = (random << 1) | random_bit;
  }
  
  srand(random);
}

void WriteReg(unsigned char address, unsigned char highbyte, unsigned char lowbyte){
  
  while(!digitalRead(MP3_DREQ));
  digitalWrite(MP3_CS, LOW);
  PicoSPI0.transfer(0x02);
  PicoSPI0.transfer(address);
  PicoSPI0.transfer(highbyte);
  PicoSPI0.transfer(lowbyte);
  while(!digitalRead(MP3_DREQ));
  digitalWrite(MP3_CS, HIGH);
  
}

void WriteReg16(unsigned char address, unsigned int databyte){
  
  while(!digitalRead(MP3_DREQ));
  digitalWrite(MP3_CS, LOW);
  PicoSPI0.transfer(0x02);
  PicoSPI0.transfer(address);
  PicoSPI0.transfer((databyte >> 8) & 0xFF);
  PicoSPI0.transfer(databyte & 0xFF);
  while(!digitalRead(MP3_DREQ));
  digitalWrite(MP3_CS, HIGH);
  
}

unsigned int ReadReg(unsigned char address){
  
  while(!digitalRead(MP3_DREQ));
  digitalWrite(MP3_CS, LOW);
  PicoSPI0.transfer(0x03);
  PicoSPI0.transfer(address);
  char response1 = PicoSPI0.transfer(0xFF);
  while(!digitalRead(MP3_DREQ));
  char response2 = PicoSPI0.transfer(0xFF);
  while(!digitalRead(MP3_DREQ));
  digitalWrite(MP3_CS, HIGH);
  int resultvalue = response1 << 8;
  resultvalue |= response2;
  return resultvalue;
  
}

#define PLUGIN_SIZE 840

const static word plugin[PLUGIN_SIZE] PROGMEM = {
  0x0007,0x0001, /*copy 1*/
	0x8d00,
	0x0006,0x033c, /*copy 828*/
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	0x2a03,0x408e};


void load_code(void){
  
  int i = 0;
  while (i< PLUGIN_SIZE) {
    word addr, n, val;
    addr = pgm_read_word (&(plugin[i++]));
    n = pgm_read_word (&(plugin[i++]));
    if (n & 0x8000U) {
      n &= 0x7FFF;
      val = pgm_read_word (&(plugin[i++]));
      while (n--) {
        WriteReg16(addr, val);       
      }
    } 
    else {
      while (n--) {
        val = pgm_read_word (&(plugin[i++]));
        WriteReg16(addr, val);        
      }
    }
  }
  return;
}

void setup() {

  seed_random_from_rosc();
  analogReadResolution(12);
    
  pinMode(MP3_DREQ, INPUT);
  pinMode(MP3_CS, OUTPUT);
  pinMode(MP3_XDCS, OUTPUT);
  pinMode(MP3_RST, OUTPUT);

  PicoSPI0.configure (MP3_CLK, MP3_MOSI, MP3_MISO, MP3_CS, 4000000, 0, true);
  PicoSPI0.transfer(0xFF);

  digitalWrite(MP3_RST, HIGH);
  digitalWrite(MP3_CS, HIGH);
  digitalWrite(MP3_XDCS, HIGH);

  load_code();

  WriteReg16(SCI_AICTRL0, SAMPLE_RATE); // sample rate
  //WriteReg16(SCI_AICTRL1, 0x10);      // GPIO4 is high if space for 32 samples
  WriteReg16(SCI_VOL, 0x0000);          // lower volume
  WriteReg16(SCI_AICTRL2, 60);          // set pcm volume
  WriteReg16(SCI_AIADDR, 0x0d00);       // start pcm mixer


}

void loop() {

  if (ReadReg(SCI_AICTRL0) > 32){

    for (int i = 0; i < 32; i++) {
      
      int8_t value;
      form1Phase += form1PhaseInc;
      value = pgm_read_byte(sinCalc+(((form1Phase>>8) & 0xf0) | form1Amp));
      form2Phase += form2PhaseInc;
      value += pgm_read_byte(sinCalc+(((form2Phase>>8) & 0xf0) | form2Amp));
      form3Phase += form3PhaseInc;
      value += pgm_read_byte(sqrCalc+(((form3Phase>>8) & 0xf0) | form3Amp));
      value = (value * (0xff^(pitchPhase>>8)))>>8;
      pitchPhase += pitchPhaseInc;

      int sample = 127 * value;  

      int reverb = ((int)reverbBuffer[reverbAddr] * REVERB_DECAY) >> FIXED_BITS;
      reverb += sample;
      reverbBuffer[reverbAddr] = reverb;
      reverbAddr++;
      if (reverbAddr > REVERB_LENGTH) reverbAddr = 0;

      int16_t output = sample + (reverbBuffer[reverbAddr]>>2); 
      
      WriteReg16(SCI_AICTRL1, output);    

      if ((pitchPhase) < pitchPhaseInc) {
        form1Phase = 0;
        form2Phase = 0;
        form3Phase = 0;
      }
      
    }
  } 

}

void loop1() {
 
  uint8_t *framePos = frameList;
  
  while(1) {

    uint8_t startFormant,staticFrames,tweenFrames;
    uint16_t startPitch,nextPitch;
    uint8_t nextFormant;
    int16_t startForm1PhaseInc,startForm2PhaseInc,startForm3PhaseInc;
    uint8_t startForm1Amp,startForm2Amp,startForm3Amp;
    uint8_t *formantPos;

    startFormant = pgm_read_byte(framePos++);
    staticFrames = pgm_read_byte(framePos++);

    if (!staticFrames) break;

    tweenFrames = pgm_read_byte(framePos++);

    startPitch = pitchTable[pgm_read_byte(framePos++)];
    nextFormant = pgm_read_byte(framePos);
    nextPitch = pitchTable[pgm_read_byte(framePos+3)];
    pitchPhaseInc = startPitch;
    formantPos = formantTable + startFormant * FORMANT_SZ;
    form1PhaseInc = startForm1PhaseInc = pgm_read_byte(formantPos++)*formantScale;
    form2PhaseInc = startForm2PhaseInc = pgm_read_byte(formantPos++)*formantScale;
    form3PhaseInc = startForm3PhaseInc = pgm_read_byte(formantPos++)*formantScale;
    form1Amp = startForm1Amp = pgm_read_byte(formantPos++);
    form2Amp = startForm2Amp = pgm_read_byte(formantPos++);
    form3Amp = startForm3Amp = pgm_read_byte(formantPos++);

    for (;staticFrames--;) delay(frameTime);
    
    if (tweenFrames) {
      uint8_t* formantPos;
      int16_t deltaForm1PhaseInc,deltaForm2PhaseInc,deltaForm3PhaseInc;
      int8_t deltaForm1Amp,deltaForm2Amp,deltaForm3Amp;
      int16_t deltaPitch;
      tweenFrames--;
      formantPos = formantTable + nextFormant * FORMANT_SZ;
      deltaForm1PhaseInc = pgm_read_byte(formantPos++)*formantScale - startForm1PhaseInc;
      deltaForm2PhaseInc = pgm_read_byte(formantPos++)*formantScale - startForm2PhaseInc;
      deltaForm3PhaseInc = pgm_read_byte(formantPos++)*formantScale - startForm3PhaseInc;
      deltaForm1Amp = pgm_read_byte(formantPos++) - startForm1Amp;
      deltaForm2Amp = pgm_read_byte(formantPos++) - startForm2Amp;
      deltaForm3Amp = pgm_read_byte(formantPos++) - startForm3Amp;
      deltaPitch = nextPitch - startPitch;
      for (int i=1; i<=tweenFrames; i++) {
        form1PhaseInc = startForm1PhaseInc + (i*deltaForm1PhaseInc)/tweenFrames;
        form2PhaseInc = startForm2PhaseInc + (i*deltaForm2PhaseInc)/tweenFrames;
        form3PhaseInc = startForm3PhaseInc + (i*deltaForm3PhaseInc)/tweenFrames;
        form1Amp = startForm1Amp + (i*deltaForm1Amp)/tweenFrames;
        form2Amp = startForm2Amp + (i*deltaForm2Amp)/tweenFrames;
        form3Amp = startForm3Amp + (i*deltaForm3Amp)/tweenFrames;
        pitchPhaseInc = startPitch + (i*deltaPitch)/tweenFrames;
        delay(frameTime);
      }
    }
  }

}