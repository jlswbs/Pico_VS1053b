/*

  Based to Logistic equation

  Pot1 = chaos constant
  Pot2 = instruments
  Pot3 = tempo

  Channel 1-6 notes 
  Channel 10 drums
 
  Created by JLS 2023

*/

#include "hardware/structs/rosc.h"
#include "PicoSPI.h"

#define MP3_CLK   2
#define MP3_MOSI  3
#define MP3_MISO  4
#define MP3_CS    5
#define MP3_XDCS  17
#define MP3_DREQ  26
#define MP3_RST   13

#define SCI_MODE          0x00
#define SCI_STATUS        0x01
#define SCI_BASS          0x02
#define SCI_CLOCKF        0x03
#define SCI_DECODE_TIME   0x04
#define SCI_AUDATA        0x05
#define SCI_WRAM          0x06
#define SCI_WRAMADDR      0x07
#define SCI_HDAT0         0x08
#define SCI_HDAT1         0x09
#define SCI_AIADDR        0x0A
#define SCI_VOL           0x0B
#define SCI_AICTRL0       0x0C
#define SCI_AICTRL1       0x0D
#define SCI_AICTRL2       0x0E
#define SCI_AICTRL3       0x0F

#define SM_DIFF           0x00
#define SM_LAYER12        0x01
#define SM_RESET          0x02
#define SM_CANCEL         0x03
#define SM_EARSPEAKER_LO  0x04
#define SM_TESTS          0x05
#define SM_STREAM         0x06
#define SM_EARSPEAKER_HI  0x07
#define SM_DACT           0x08
#define SM_SDIORD         0x09
#define SM_SDISHARE       0x0A
#define SM_SDINEW         0x0B
#define SM_ADPCM          0x0C
#define SM_ADPCM_HP       0x0D
#define SM_LINE1          0x0E
#define SM_CLK_RANGE      0x0F

#define MAXTEMPO  14    // 350 BPM 16th note
#define MINTEMPO  111   // 45 BPM 16th note
#define POLY      6     // note polyphony
#define MAXADC    4095  // max ADC value
#define MINADC    0     // min ADC value

  float x[POLY];
  float nx[POLY];
  uint8_t xout[POLY];
  uint8_t notes;
  uint8_t prog;
  uint8_t vol;

static inline void seed_random_from_rosc(){
  
  uint32_t random = 0;
  uint32_t random_bit;
  volatile uint32_t *rnd_reg = (uint32_t *)(ROSC_BASE + ROSC_RANDOMBIT_OFFSET);

  for (int k = 0; k < 32; k++) {
    while (1) {
      random_bit = (*rnd_reg) & 1;
      if (random_bit != ((*rnd_reg) & 1)) break;
    }

    random = (random << 1) | random_bit;
  }
  
  srand(random);
}

void WriteReg(unsigned char address, unsigned char highbyte, unsigned char lowbyte){
  
  while(!digitalRead(MP3_DREQ));
  digitalWrite(MP3_CS, LOW);
  PicoSPI0.transfer(0x02);
  PicoSPI0.transfer(address);
  PicoSPI0.transfer(highbyte);
  PicoSPI0.transfer(lowbyte);
  while(!digitalRead(MP3_DREQ));
  digitalWrite(MP3_CS, HIGH);
  
}

void WriteReg16(unsigned char address, unsigned int databyte){
  
  while(!digitalRead(MP3_DREQ));
  digitalWrite(MP3_CS, LOW);
  PicoSPI0.transfer(0x02);
  PicoSPI0.transfer(address);
  PicoSPI0.transfer((databyte >> 8) & 0xFF);
  PicoSPI0.transfer(databyte & 0xFF);
  while(!digitalRead(MP3_DREQ));
  digitalWrite(MP3_CS, HIGH);
  
}

unsigned int ReadReg(unsigned char address){
  
  while(!digitalRead(MP3_DREQ));
  digitalWrite(MP3_CS, LOW);
  PicoSPI0.transfer(0x03);
  PicoSPI0.transfer(address);
  char response1 = PicoSPI0.transfer(0xFF);
  while(!digitalRead(MP3_DREQ));
  char response2 = PicoSPI0.transfer(0xFF);
  while(!digitalRead(MP3_DREQ));
  digitalWrite(MP3_CS, HIGH);
  int resultvalue = response1 << 8;
  resultvalue |= response2;
  return resultvalue;
  
}

void note_on(byte chan, byte inst, byte note, byte vol){

  WriteReg16(SCI_MODE, 0x0c00);

  PicoSPI0.transfer(0xC0 | chan);
  PicoSPI0.transfer(0x00);
  PicoSPI0.transfer(inst);
  PicoSPI0.transfer(0x00);
  
  PicoSPI0.transfer(0x90 | chan);
  PicoSPI0.transfer(0x00);
  PicoSPI0.transfer(note);
  PicoSPI0.transfer(0x00);
  PicoSPI0.transfer(vol);
  PicoSPI0.transfer(0x00);

}

void note_off(byte chan, byte note){

  WriteReg16(SCI_MODE, 0x0c00);

  PicoSPI0.transfer(0x80 | chan);
  PicoSPI0.transfer(0x00);
  PicoSPI0.transfer(note);
  PicoSPI0.transfer(0x00);
  PicoSPI0.transfer(0x00);
  PicoSPI0.transfer(0x00);
  
}

void reverb(byte chan, byte typ, byte rev){
  
  WriteReg16(SCI_MODE, 0x0c00);

  PicoSPI0.transfer(0xB0 | chan);
  PicoSPI0.transfer(0x00);
  PicoSPI0.transfer(0x5B);
  PicoSPI0.transfer(0x00);
  PicoSPI0.transfer(rev);
  PicoSPI0.transfer(0x00);
  
  PicoSPI0.transfer(0xB0 | chan);
  PicoSPI0.transfer(0x00);
  PicoSPI0.transfer(0x0C);
  PicoSPI0.transfer(0x00);
  PicoSPI0.transfer(typ);
  PicoSPI0.transfer(0x00);

}

void panning(byte chan, byte pan){
  
  WriteReg16(SCI_MODE, 0x0c00);

  PicoSPI0.transfer(0xB0 | chan);
  PicoSPI0.transfer(0x00);
  PicoSPI0.transfer(0x0A);
  PicoSPI0.transfer(0x00);
  PicoSPI0.transfer(pan);
  PicoSPI0.transfer(0x00);

}

void all_sound_off(byte chan){
  
  WriteReg16(SCI_MODE, 0x0c00);
  
  PicoSPI0.transfer(0xB0 | chan);
  PicoSPI0.transfer(0x00);
  PicoSPI0.transfer(0x78);
  PicoSPI0.transfer(0x00);
  PicoSPI0.transfer(0xFF);
  PicoSPI0.transfer(0x00);

}

void pitch(byte chan, byte pitch){

  WriteReg16(SCI_MODE, 0x0c00);

  PicoSPI0.transfer(0xE0 | chan);
  PicoSPI0.transfer(0x00);
  PicoSPI0.transfer(pitch);
  PicoSPI0.transfer(0x00);

}

void SetVolume(unsigned char left, unsigned char right){ WriteReg(SCI_VOL, left, right); }


const static word plugin[1039] PROGMEM = { /* Compressed plugin */
  0x0007,0x0001, /*copy 1*/
  0x8050,
  0x0006,0x03f0, /*copy 1008*/
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  0x2a00,0x1a0e,0x000a,0x0001,0x0050,};

#define PLUGIN_SIZE 1039

void load_code(void){
  
  int i = 0;
  while (i< PLUGIN_SIZE) {
    word addr, n, val;
    addr = pgm_read_word (&(plugin[i++]));
    n = pgm_read_word (&(plugin[i++]));
    if (n & 0x8000U) {
      n &= 0x7FFF;
      val = pgm_read_word (&(plugin[i++]));
      while (n--) {
        WriteReg16(addr, val);       
      }
    } 
    else {
      while (n--) {
        val = pgm_read_word (&(plugin[i++]));
        WriteReg16(addr, val);        
      }
    }
  }
  return;
}

void setup(){

  seed_random_from_rosc();
  analogReadResolution(12);
    
  pinMode(MP3_DREQ, INPUT);
  pinMode(MP3_CS, OUTPUT);
  pinMode(MP3_XDCS, OUTPUT);
  pinMode(MP3_RST, OUTPUT);

  PicoSPI0.configure (MP3_CLK, MP3_MOSI, MP3_MISO, MP3_CS, 8000000, 0, true);
  PicoSPI0.transfer(0xFF);

  digitalWrite(MP3_RST, HIGH);
  digitalWrite(MP3_CS, HIGH);
  digitalWrite(MP3_XDCS, HIGH);

  load_code();

  SetVolume(65, 65); // Set initial volume (20 = -10dB)
  WriteReg16(SCI_CLOCKF, 0x8BE8); // Set multiplier to 3.5x

  uint8_t room = 0;

  reverb(0, room, 96);
  reverb(1, room, 96);
  reverb(2, room, 96);
  reverb(3, room, 96);
  reverb(4, room, 96);
  reverb(5, room, 96);

  panning(0, 32);
  panning(1, 96);
  panning(2, 48);
  panning(3, 80);
  panning(4, 40);
  panning(5, 88);

  for (int i = 0; i < POLY; i++) x[i] = 0.1f;

}

void loop(){

  float r = map(analogRead(A1), MINADC, MAXADC, 35000, 39900);
  r /= 10000.0f;  

  for (int i = 0; i < POLY; i++){

    r += 0.01f;
    nx[i] = x[i];
    x[i] = r * nx[i] * (1.0f - nx[i]);
    xout[i] = 127.0f * x[i];
             
    //MIDI.sendProgramChange(rand()%128, 1+i);
   
  }

  char t = 0;

  for (int i = 0; i < POLY; i++) t ^= (char)(xout[i]);

  for (int i = 0; i < POLY; i++){  
  
    vol = map(xout[i], 0, 127, 32, 96);
    prog = map(analogRead(A2), 0, MAXADC, 0, xout[i]);
    if (prog >= 18 && prog <= 23) prog = 0; // replace some instruments to grand piano
    notes = map(xout[i], 0, 127, 12, 28 + (xout[i] / 2)); // quantise note
    if(bitRead(t, i)) note_on(i, prog & 123, notes & 127, vol & 127);

  }
 
  uint8_t drum = map(t & 127, 0, 127, 35, 66); // note 27-87 drum kit
  uint8_t vold = map(t, 0, 127, 48, 88);
  note_on(9, 0, drum & 127, vold & 127);

  uint8_t delay_ms = map(analogRead(A3), MINADC, MAXADC, MINTEMPO, MAXTEMPO);

  delay(2 * delay_ms);

  uint8_t rel_off = t % 6;
  
  if(rel_off == 0) all_sound_off(0);
  if(rel_off == 1) all_sound_off(1);
  if(rel_off == 2) all_sound_off(2);
  if(rel_off == 3) all_sound_off(3);
  if(rel_off == 4) all_sound_off(4);
  if(rel_off == 5) all_sound_off(5);

  delay (delay_ms);

}
